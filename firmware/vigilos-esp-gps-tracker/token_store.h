/**
 * VigilOS Token Store — Non-Volatile Device Token Persistence
 *
 * Implements PRD 3.2: tokens persist across reboots/power cycles using
 * LittleFS (`/token.txt`) with EEPROM fallback on legacy ESP8266 boards.
 */

#pragma once

#include <Arduino.h>
#include <string.h>

// ---- EEPROM fallback parameters -------------------------------------------
#define TOKEN_EEPROM_ADDR   0
#define TOKEN_EEPROM_SIZE   128

#if defined(ARDUINO_ARCH_ESP32)
  #include <LittleFS.h>
  #include <EEPROM.h>
  #define TOKEN_FILE "/token.txt"
#elif defined(ESP8266)
  #include <LittleFS.h>
  #include <EEPROM.h>
  #define TOKEN_FILE "/token.txt"
#endif

class TokenStore {
public:
  bool begin() {
#if defined(ARDUINO_ARCH_ESP32) || defined(ESP8266)
    bool ok = LittleFS.begin();
    if (ok) loadToken();
    return ok;
#else
    EEPROM.begin(TOKEN_EEPROM_SIZE);
    loadToken();
    return true;
#endif
  }

  bool hasToken() {
    return getToken()[0] != '\0';
  }

  const char* getToken() {
    return _token;
  }

  void printMasked() {
    size_t len = strlen(_token);
    if (len == 0) {
      Serial.println(F("[TokenStore] (empty)"));
      return;
    }
    Serial.printf("[TokenStore] token=%s...%s (len=%u)\n",
                  String(_token).substring(0, 9).c_str(),
                  String(_token).substring(len > 8 ? len - 8 : 0).c_str(),
                  (unsigned)len);
  }

  /**
   * Validate + persist a device token.
   * Tokens are 32-character alphanumeric strings generated by the backend
   * (e.g. `vgl_live_7f8a9b0c1d2e3f4a5b6c7d8e9f0a1b2c`).
   */
  bool saveToken(const String& token) {
    if (token.length() < 32) return false;
    for (size_t i = 0; i < token.length(); i++) {
      char c = token.charAt(i);
      bool alnum = (c >= 'a' && c <= 'z') || (c >= 'A' && c <= 'Z') || (c >= '0' && c <= '9');
      bool allowed = alnum || c == '_' || c == '-' || c == '.';
      if (!allowed) return false;
    }

    strncpy(_token, token.c_str(), sizeof(_token) - 1);
    _token[sizeof(_token) - 1] = '\0';

#if defined(ARDUINO_ARCH_ESP32) || defined(ESP8266)
    File f = LittleFS.open(TOKEN_FILE, "w");
    if (!f) return false;
    f.print(_token);
    f.close();
    return true;
#else
    for (int i = 0; i < TOKEN_EEPROM_SIZE; i++) {
      EEPROM.write(TOKEN_EEPROM_ADDR + i, i < (int)strlen(_token) ? _token[i] : 0);
    }
    EEPROM.commit();
    return true;
#endif
  }

  /** Remove the stored token (used on authentication rejection). */
  void erase() {
    _token[0] = '\0';
#if defined(ARDUINO_ARCH_ESP32) || defined(ESP8266)
    LittleFS.remove(TOKEN_FILE);
#else
    for (int i = 0; i < TOKEN_EEPROM_SIZE; i++) {
      EEPROM.write(TOKEN_EEPROM_ADDR + i, 0);
    }
    EEPROM.commit();
#endif
  }

  TokenStore() {
    _token[0] = '\0';
  }

private:
  void loadToken() {
    _token[0] = '\0';
#if defined(ARDUINO_ARCH_ESP32) || defined(ESP8266)
    if (LittleFS.exists(TOKEN_FILE)) {
      File f = LittleFS.open(TOKEN_FILE, "r");
      if (f) {
        String content = f.readString();
        f.close();
        content.trim();
        if (content.length() > 0) {
          strncpy(_token, content.c_str(), sizeof(_token) - 1);
        }
      }
    }
#else
    EEPROM.get(TOKEN_EEPROM_ADDR, _token);
#endif
    _token[sizeof(_token) - 1] = '\0';
  }

  char _token[128];
};

TokenStore tokenStore;
